## zcu102/xilinx-zcu102-2017.1/project-spec/meta-plnx-generated/conf/machine/plnx_aarch64.conf
```bitbake
require conf/machine/include/tune-zynqmp.inc
require conf/machine/include/machine-xilinx-board.inc
require conf/machine/include/machine-xilinx-default.inc

PREFERRED_PROVIDER_virtual/kernel = "linux-xlnx"
PREFERRED_PROVIDER_virtual/bootloader = "u-boot-xlnx"
PREFERRED_PROVIDER_virtual/dtb = "device-tree-generation"
PREFERRED_PROVIDER_virtual/hdf = "external-hdf"
PREFERRED_PROVIDER_virtual/bitstream = "bitstream-extraction"
EXTRA_IMAGEDEPENDS += "device-tree-generation"
PREFERRED_PROVIDER_virtual/libgles1 = "libmali-xlnx"
PREFERRED_PROVIDER_virtual/libgles2 = "libmali-xlnx"
PREFERRED_PROVIDER_virtual/egl = "libmali-xlnx"
PREFERRED_PROVIDER_virtual/fsbl = "fsbl"
EXTRA_IMAGEDEPENDS += "fsbl"
PREFERRED_PROVIDER_virtual/pmufw = "pmu-firmware"
EXTRA_IMAGEDEPENDS += "pmu-firmware"
PREFERRED_PROVIDER_virtual/arm-trusted-firmware = "arm-trusted-firmware"
EXTRA_IMAGEDEPENDS += "arm-trusted-firmware"
UBOOT_MACHINE = "xilinx_zynqmp_zcu102_config"
IMAGE_FSTYPES_append = " cpio.gz ext4 ext3 ext4.gz"
SERIAL_CONSOLE= "115200 ttyPS0"
MACHINE_EXTRA_RRECOMMENDS += " kernel-modules"
MACHINE_FEATURES = "rtc ext2 ext3 vfat usbhost"
```
